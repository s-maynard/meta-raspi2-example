## conf/bblayers.conf.sample
```bitbake
# LAYER_CONF_VERSION is increased each time build/conf/bblayers.conf
# changes incompatibly
LCONF_VERSION = "6"

BBPATH = "${TOPDIR}"
BBFILES ?= ""

BBLAYERS ?= " \
  ##COREBASE##/meta \
  ##COREBASE##/meta-yocto \
  ##COREBASE##/meta-yocto-bsp \
  ##COREBASE##/meta-openembedded/meta-filesystems \
  ##COREBASE##/meta-openembedded/meta-multimedia \
  ##COREBASE##/meta-openembedded/meta-networking \
  ##COREBASE##/meta-openembedded/meta-oe \
  ##COREBASE##/meta-openembedded/meta-python \
  ##COREBASE##/meta-openembedded/meta-webserver \
  ##COREBASE##/meta-raspberrypi \
  ##COREBASE##/meta-raspi2-example \
  "
BBLAYERS_NON_REMOVABLE ?= " \
  ##COREBASE##/meta \
  ##COREBASE##/meta-yocto \
  "
```

## conf/layer.conf
```bitbake
BBPATH .= ":${LAYERDIR}"

BBFILES += "\
            ${LAYERDIR}/recipes-*/*/*.bb \
            ${LAYERDIR}/recipes-*/*/*.bbappend \
           "

BBFILE_COLLECTIONS += "raspi2"
BBFILE_PATTERN_raspi2 := "^${LAYERDIR}/"
BBFILE_PRIORITY_raspi2 = "7"

LAYERVERSION_raspi2 = "1"
LAYERDEPENDS_raspi2 = "core"

# Additional license directories.
LICENSE_PATH += "${LAYERDIR}/licenses"
```
